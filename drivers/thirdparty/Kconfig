## drivers/thirdparty/Kconfig
```kconfig
# SPDX-License-Identifier: GPL-2.0
menu "Thirdparty Drivers"

config THIRDPARTY_BNXT
	bool
	default y

endmenu
```

## kernel/Kconfig.tkernel
```kconfig
# SPDX-License-Identifier: GPL-2.0-only

# For TKernel features
source "kernel/tkernel/Kconfig"
```

## kernel/rue/Kconfig
```kconfig
# SPDX-License-Identifier: GPL-2.0
#
# Tencent RUE configuration
#

config RUE
	tristate "Resource Utilization Enhancement"
	default y
	help
	  Rue provides cgroup level resource isolation. It can help user to
	  increase resource utilization. Rue contains four subsystems:
	  cpu, memory, io, network. It allocates resource according to the
	  priority of the cgroup.
```

## kernel/tkernel/Kconfig
```kconfig
# SPDX-License-Identifier: GPL-2.0-only
#
# TKernel configuration
#
menuconfig TKERNEL
	bool "Tencent Kernel Features"
	default y

if TKERNEL

config TKERNEL_NONPRIV_NETBIND
	bool "Allow non-privileged user to bind specific low ports"
	default n

config TKERNEL_TTOOLS
	tristate "Tencent Kernel TTools"
	default n

config TKERNEL_NETATOP
	tristate 'Netatop support'
	default n
	depends on NETFILTER
	help
		Netatop module from TKernel

config TKERNEL_SHIELD_MOUNTS
	bool 'Shield mount'
	default n

config TKERNEL_SECURITY_MONITOR
	bool "security monitor"
	default y
	help
		Allow user to add security monitor

config TKERNEL_AEGIS_MODULE
	tristate "ONION aegis module"
	default m
	help
		ONION aegis module

config TKERNEL_IRQ_LATENCY
	tristate "irq latency debug"
	depends on STACKTRACE
	depends on X86
	default m
	help
	  This option adds support for irq latency debug.

config TKERNEL_KILL_HOOK
	bool "kill hook"
	default n
	help
	  This option enables the kill hook interface to support
	  kill interception.

config TKERNEL_KILL_BLOCK
	tristate "block kill signal"
	default m
	depends on CGROUPS
	select GLOB
	select TKERNEL_KILL_HOOK
	help
	  This option enables the kill block feature.
	  If the kill signal match the block rule, it will be blocked.
	  This feature is useful to some k8s user who don't allow k8s
	  kill user process.

endif
```

## security/integrity/dim/Kconfig
```kconfig
# SPDX-License-Identifier: GPL-2.0-only
# Dynamic Integrity Measurement Architecture
#
config DIM
    bool "DIM (Dynamic Integrity Measurement)"
    depends on INTEGRITY
    default y
    help
      The Dynamic Integrity Measurement(DIM) architechture maintains a list
      of hash values of executables and running processes. If an attacker
      manages to change the executables being measured, we can tell.

      If your system has a TPM chip, then DIM can extend the hash value to
      the TPM hardware, so that the TPM can prove to a third party whether
      or not critical executables have been modified.
      If unsure, say N.

if DIM

config DIM_CORE
    tristate "DIM core module support"
    default m
    help
      Enable the dim_core module of DIM architechture.

      This option enables the dim_core security module, which provides
      integrity measurement for running processes. If unsure, say M.

config DIM_HASH_SUPPORT_SM3
    bool "Enable SM3 hash algorithm support for DIM"
    depends on DIM_CORE
    default y
    help
      Enable support for the SM3 hash algorithm in DIM.

      If this option is enabled, the DIM module will be built with
      support for the SM3 hash algorithm. If unsure, say N.

config DIM_MONITOR
    tristate "DIM monitor module support"
    depends on DIM_CORE
    default m
    help
      Enable the dim_monitor module of DIM architechture.

      This option enables the dim_monitor security module, which provides
      integrity measurement for dim_core. If unsure, say N.

endif  # If DIM
```
